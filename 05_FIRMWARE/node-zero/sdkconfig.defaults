## 05_FIRMWARE/node-zero/sdkconfig.defaults
```kconfig
# ── P31 Node Zero — sdkconfig.defaults ───────────────────────────────────────
# ESP-IDF 5.5.x · ESP32-S3-WROOM-1 N16R8

# ── Flash ─────────────────────────────────────────────────────────────────────
CONFIG_ESPTOOLPY_FLASHSIZE_16MB=y
CONFIG_ESPTOOLPY_FLASHMODE_QIO=y
CONFIG_ESPTOOLPY_FLASHFREQ_80M=y
CONFIG_PARTITION_TABLE_CUSTOM=y
CONFIG_PARTITION_TABLE_CUSTOM_FILENAME="partitions.csv"

# ── Octal PSRAM (N16R8 — CRITICAL: must be OCT not QUAD) ─────────────────────
# If QUAD is enabled here the OPI PSRAM won't initialize → display DMA underrun
CONFIG_SPIRAM=y
CONFIG_SPIRAM_MODE_OCT=y
CONFIG_SPIRAM_SPEED_80M=y
CONFIG_SPIRAM_USE_CAPS_ALLOC=y
CONFIG_SPIRAM_MALLOC_ALWAYSINTERNAL=0
CONFIG_SPIRAM_TRY_ALLOCATE_WIFI_LWIP=y
CONFIG_SPIRAM_ALLOW_BSS_SEG_EXTERNAL_MEMORY=y

# ── CPU ───────────────────────────────────────────────────────────────────────
CONFIG_ESP32S3_DEFAULT_CPU_FREQ_240=y

# ── FreeRTOS ──────────────────────────────────────────────────────────────────
CONFIG_FREERTOS_HZ=1000
CONFIG_FREERTOS_UNICORE=n
CONFIG_FREERTOS_TIMER_TASK_STACK_DEPTH=4096
CONFIG_ESP_TASK_WDT_TIMEOUT_S=10

# ── Logging ───────────────────────────────────────────────────────────────────
CONFIG_LOG_DEFAULT_LEVEL_INFO=y

# ── USB serial (CDC for debug during development) ─────────────────────────────
CONFIG_ESP_CONSOLE_USB_CDC=y
CONFIG_USB_OTG_SUPPORTED=y

# ── WiFi ─────────────────────────────────────────────────────────────────────
CONFIG_ESP_WIFI_STATIC_RX_BUFFER_NUM=4
CONFIG_ESP_WIFI_DYNAMIC_RX_BUFFER_NUM=8
CONFIG_ESP_WIFI_TX_BUFFER_TYPE_DYNAMIC=y

# ── NVS ──────────────────────────────────────────────────────────────────────
CONFIG_NVS_ENCRYPTION=n

# ── Secure Boot (disabled for dev; enable for production Abdication) ──────────
CONFIG_SECURE_BOOT=n
CONFIG_SECURE_FLASH_ENC_ENABLED=n

# ── LVGL task stack (enlarged for PSRAM buffer ops) ──────────────────────────
CONFIG_ESP_MAIN_TASK_STACK_SIZE=8192
```
