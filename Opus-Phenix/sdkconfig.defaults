## Opus-Phenix/sdkconfig.defaults
```kconfig
# Critical settings from xiaozhi
CONFIG_ESP_DEFAULT_CPU_FREQ_MHZ_240=y
CONFIG_ESPTOOLPY_FLASHSIZE_16MB=y
CONFIG_ESPTOOLPY_FLASHMODE_QIO=y

# PSRAM - CRITICAL for stable operation  
CONFIG_SPIRAM=y
CONFIG_SPIRAM_MODE_OCT=y
CONFIG_SPIRAM_SPEED_80M=y
CONFIG_SPIRAM_MALLOC_ALWAYSINTERNAL=512
CONFIG_SPIRAM_MALLOC_RESERVE_INTERNAL=65536
CONFIG_SPIRAM_MEMTEST=n

# Cache optimization
CONFIG_ESP32S3_INSTRUCTION_CACHE_32KB=y
CONFIG_ESP32S3_DATA_CACHE_LINE_64B=y

# System
CONFIG_ESP_SYSTEM_EVENT_TASK_STACK_SIZE=4096

# USB CDC Console
CONFIG_ESP_CONSOLE_USB_SERIAL_JTAG=y
```
